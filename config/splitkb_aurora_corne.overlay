#include <dt-bindings/zmk/mouse.h>

/ {
    // Hardware-Definition für den mittleren Mausbutton an Pin 7 (P0.22)
    buttons {
        compatible = "gpio-keys";
        mmb_button: mmb_button {
            gpios = <&gpio0 22 (GPIO_ACTIVE_LOW | GPIO_PULL_UP)>;
            label = "Middle Mouse Button";
        };
    };
};

/* * Direkte Hardware-Konfiguration für den Kailh 10 Encoder.
 * Wir nutzen die korrekten Pins laut Schaltplan:
 * ENC1_A an Pin 18 (P1.15)
 * ENC1_B an Pin 17 (P0.02)
 */
&{/soc/peripheral@40000000/spi@b000/encoder@0} {
    status = "okay";
    a-gpios = <&gpio1 15 (GPIO_ACTIVE_LOW | GPIO_PULL_UP)>;
    b-gpios = <&gpio0 2 (GPIO_ACTIVE_LOW | GPIO_PULL_UP)>;
    steps = <24>;
};
