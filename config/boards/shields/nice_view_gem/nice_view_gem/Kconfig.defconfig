## config/boards/shields/nice_view_gem/nice_view_gem/Kconfig.defconfig
```kconfig
if SHIELD_NICE_VIEW_GEM
    config ZMK_DISPLAY
        default y

    config LV_Z_VDB_CUSTOM
        default y
    
    config LV_VDB_SIZE
        default 64

    # Hier kommt die Rotation rein:
    config LV_Z_ROTATE_180
        default y
endif
```

## config/west.yml
```yaml
manifest:
  remotes:
    - name: zmkfirmware
      url-base: https://github.com/zmkfirmware
  projects:
    - name: zmk
      remote: zmkfirmware
      # Wir nutzen einen stabilen Stand vor dem Zephyr 4.1 Update
      revision: v0.19.0 
      import: app/west.yml
    - name: nice-view-gem
      url: https://github.com/M165437/nice-view-gem
      revision: main
  self:
    path: configconfig
```
