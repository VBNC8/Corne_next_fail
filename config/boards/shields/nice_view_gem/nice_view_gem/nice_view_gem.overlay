&nice_view_spi {
    nice_view: ls0xx@0 {
        compatible = "sharp,ls0xx";
        reg = <0>;
        spi-max-frequency = <1000000>;
        width = <160>;   /* Tausche width und height */
        height = <68>;
    };
};

/ {
    chosen {
        zmk,display = &nice_view;
    };
};
